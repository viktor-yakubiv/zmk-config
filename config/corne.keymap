/*
 * Copyright (c) 2020 The ZMK Contributors
 *
 * SPDX-License-Identifier: MIT
 */

#include <behaviors.dtsi>
#include <behaviors/num_word.dtsi>
#include <behaviors/unicode.dtsi>

#include <dt-bindings/zmk/keys.h>
#include <dt-bindings/zmk/bt.h>

#include <zmk-helpers/key-labels/42.h>
#include <zmk-helpers/helper.h>

#include "behaviors/bluetooth.dtsi"
#include "behaviors/homerowmods.dtsi"
#include "behaviors/layer-switching.dtsi"


/**
 * Layers
 *
 * The following icons from a Nerd Font
 * are the symbolid representation of layers and actions on layers.
 *
 * 󰱞   Close current layer, return to base layer
 *
 * 󰪸   Typing layer
 * 󰎢   Base layer
 * 󰎥   Numbers
 * 󰎨   Symbols
 * 󰼄   Media
 * 󱊇   System
 *
 * 󱅅   *unused*
 * 󱏦   *unused*
 * 󱥭   *unused*
 */
#define L_BASE     0
#define L_ENTHIUM  L_BASE
#define L_KVANT    1
#define L_NAV      2
#define L_NUMBERS  3
#define L_SYMBOLS  3
#define L_NUMSYM   3
#define L_SYSTEM   4

// Keys require layer definitions
#include "keys.dtsi"

#define ZMK_BASE_LAYER(name, LT, RT, LM, RM, LB, RB, LH, RH) \
    ZMK_LAYER(name,                                          \
        LT RT                                                \
        LM RM                                                \
        LB RB                                                \
        LH RH                                                \
    )

#define ____ &trans
#define NONE &none


&caps_word {
  continue-list = <UNDERSCORE MINUS BACKSPACE DELETE>;
};

&uc {
    default-mode = <UC_MODE_MACOS>;
    minimum-length = <4>; // MacOS expects exactly 4-key long sequences
};

&mt { MT_CORE };

/**
 * The Base Layer — Enthium
 *
 * The layout was designed by Suraj N. Kurapati (@sunaku)
 * originally in 2024 and reviewed multiple times by 30 January 2026,
 * when the latest Enthium v14 was published.
 *
 * Find out more about the layout at
 *   https://sunaku.github.io/enthium-keyboard-layout.html
 *   https://layouts.wiki/layouts/2026/enthium/
 *
 * The layout below is my adaptation of the Enthium v14 to Corne 3×6.
 * I originally started with Enthium v14, then tried v12, and suddenly,
 * found reasonable to stick with the latest version.
 * I have been finding unlogical having W on right pinky for the Vim uses:
 * the 'change word' (`ciw`, `caw`) and 'delete word' (`diw`, `daw`) motions
 * are very common and I use them a lot.
 */
ZMK_BASE_LAYER(Enthium,
//╭────────┲━━━━━━━━┳━━━━━━━━┳━━━━━━━━┳━━━━━━━━┳━━━━━━━━┓  ┏━━━━━━━━┳━━━━━━━━┳━━━━━━━━┳━━━━━━━━┳━━━━━━━━┱────────╮ //
    C_NAV    &kp Q    &kp Y    &kp O    &kp U    C_EQUAL,    &kp X    &kp L    &kp D    &kp P    &kp Z    C_NUM  ,
//├────────╊━━━━━━━━╋━━━━━━━━╋━━━━━━━━╋━━━━━━━━╋━━━━━━━━┫  ┣━━━━━━━━╋━━━━━━━━╋━━━━━━━━╋━━━━━━━━╋━━━━━━━━╉────────┤ //
    &kp B    LHM4(C)  LHM3(I)  LHM2(A)  LHM1(E)  C_MINUS,    &kp K   RHM1(H)  RHM2(T)  RHM3(N)   RHM4(S)  &kp W  ,
//├────────╊━━━━━━━━╋━━━━━━━━╋━━━━━━━━╋━━━━━━━━╋━━━━━━━━┫  ┣━━━━━━━━╋━━━━━━━━╋━━━━━━━━╋━━━━━━━━╋━━━━━━━━╉────────┤ //
     NONE    C_SQT   C_COMMA   C_DOT    C_SEMI   C_FSLH ,    &kp J    &kp M    &kp G    &kp F    &kp V     NONE  ,
//╰────────┺━━━━━━━━┻━━━━━━━━╇━━━━━━━━╇━━━━━━━━╇━━━━━━━━┩  ┡━━━━━━━━╇━━━━━━━━╇━━━━━━━━╇━━━━━━━━┻━━━━━━━━┹────────╯ //
                              &kp ESC   C_SPC    C_TAB  ,    C_RET    RHM5(R) &kp BSPC
//                           ╰────────┴────────┴────────╯  ╰────────┴────────┴────────╯                            //
)

/**
 * The Kvant layout
 *
 * The layout was designed by Giorgi Chavchanidze.
 *
 * Find out more about the layout at
 *   https://lykt.xyz/kvant/
 *
 * This is my adaptation to Corne, including some letter switches
 * to align also with the underneeth Enthium layer.
 */

// Shorter definition for Й
#define UC_UK_J   UC_UK_I_SHORT
#define UC_UK_YE  UC_UK_IE

#define UK(LETTER_NAME) &uc UC_UK_##LETTER_NAME

ZMK_BASE_LAYER(Kvant,
//╭────────┲━━━━━━━━┳━━━━━━━━┳━━━━━━━━┳━━━━━━━━┳━━━━━━━━┓  ┏━━━━━━━━┳━━━━━━━━┳━━━━━━━━┳━━━━━━━━┳━━━━━━━━┱────────╮ //
    UK(F)    UK(SH)   UK(Z)    UK(E)    UK(U)    UK(YU) ,    UK(B)     UK(P)   UK(R)    UK(M)    UK(ZH) &kp MINUS,
//├────────╊━━━━━━━━╋━━━━━━━━╋━━━━━━━━╋━━━━━━━━╋━━━━━━━━┫  ┣━━━━━━━━╋━━━━━━━━╋━━━━━━━━╋━━━━━━━━╋━━━━━━━━╉────────┤ //
    UK(SCH)  UK(D)    UK(S)    UK(I)    UK(A)    UK(Y)  ,    UK(K)     UK(V)   UK(N)    UK(T)    UK(L)    UK(TS) ,
//├────────╊━━━━━━━━╋━━━━━━━━╋━━━━━━━━╋━━━━━━━━╋━━━━━━━━┫  ┣━━━━━━━━╋━━━━━━━━╋━━━━━━━━╋━━━━━━━━╋━━━━━━━━╉────────┤ //
     ____  &kp COMMA  UK(CH)  UK(SOFT)  UK(YA)   UK(YI) ,    UK(H)     UK(J)   UK(YE)   UK(KH)   &kp DOT   UK(G) ,   \
//╰────────┺━━━━━━━━┻━━━━━━━━╇━━━━━━━━╇━━━━━━━━╇━━━━━━━━┩  ┡━━━━━━━━╇━━━━━━━━╇━━━━━━━━╇━━━━━━━━┻━━━━━━━━┹────────╯ //
                                ____     ____     ____  ,     ____    UK(O)     ____
//                           ╰────────┴────────┴────────╯  ╰────────┴────────┴────────╯                            //
)

#define SKM(_N) &sk LHRM ## _N
ZMK_BASE_LAYER(Navigation,
//╭────────┲━━━━━━━━┳━━━━━━━━┳━━━━━━━━┳━━━━━━━━┳━━━━━━━━┓  ┏━━━━━━━━┳━━━━━━━━┳━━━━━━━━┳━━━━━━━━┳━━━━━━━━┱────────╮ //
    C_ESC     ____     QUIT    CLOSE     ____     ____  ,  &kp PG_UP C_DTPRV    C_UP   C_DTNXT    ____     ____  ,
//├────────╊━━━━━━━━╋━━━━━━━━╋━━━━━━━━╋━━━━━━━━╋━━━━━━━━┫  ┣━━━━━━━━╋━━━━━━━━╋━━━━━━━━╋━━━━━━━━╋━━━━━━━━╉────────┤ //
     ____    SKM(4)   SKM(3)   SKM(2)   SKM(1)    ____  ,  &kp PG_DN  C_LEFT   C_DOWN   C_RIGHT &kp RET    ____  ,
//├────────╊━━━━━━━━╋━━━━━━━━╋━━━━━━━━╋━━━━━━━━╋━━━━━━━━┫  ┣━━━━━━━━╋━━━━━━━━╋━━━━━━━━╋━━━━━━━━╋━━━━━━━━╉────────┤ //
     ____     ____     ____     ____     ____     ____  ,     ____     ____     ____     ____     ____     ____  ,
//╰────────┺━━━━━━━━┻━━━━━━━━╇━━━━━━━━╇━━━━━━━━╇━━━━━━━━┩  ┡━━━━━━━━╇━━━━━━━━╇━━━━━━━━╇━━━━━━━━┻━━━━━━━━┹────────╯ //
                               CANCEL    ____     ____  ,     ____     ____     ____
//                           ╰────────┴────────┴────────╯  ╰────────┴────────┴────────╯                            //
)

ZMK_BASE_LAYER(Numbers,
//╭────────┲━━━━━━━━┳━━━━━━━━┳━━━━━━━━┳━━━━━━━━┳━━━━━━━━┓  ┏━━━━━━━━┳━━━━━━━━┳━━━━━━━━┳━━━━━━━━┳━━━━━━━━┱────────╮ //
     ____     ____    &kp N7   &kp N4   &kp N1    ____  ,     ____     ____     ____     ____     ____     ____  ,
//├────────╊━━━━━━━━╋━━━━━━━━╋━━━━━━━━╋━━━━━━━━╋━━━━━━━━┫  ┣━━━━━━━━╋━━━━━━━━╋━━━━━━━━╋━━━━━━━━╋━━━━━━━━╉────────┤ //
     ____    &kp N0  LHM3(N8) LHM2(N5) LHM1(N2)   ____  ,     ____     ____     ____     ____     ____     ____  ,
//├────────╊━━━━━━━━╋━━━━━━━━╋━━━━━━━━╋━━━━━━━━╋━━━━━━━━┫  ┣━━━━━━━━╋━━━━━━━━╋━━━━━━━━╋━━━━━━━━╋━━━━━━━━╉────────┤ //
     ____     ____    &kp N9   &kp N6   &kp N3    ____  ,     ____     ____     ____     ____     ____     ____  ,
//╰────────┺━━━━━━━━┻━━━━━━━━╇━━━━━━━━╇━━━━━━━━╇━━━━━━━━┩  ┡━━━━━━━━╇━━━━━━━━╇━━━━━━━━╇━━━━━━━━┻━━━━━━━━┹────────╯ //
                                ____    &kp DOT   ____  ,     ____     ____     ____
//                           ╰────────┴────────┴────────╯  ╰────────┴────────┴────────╯                            //
)

#define BTK(_N) &bt BT_SEL _N
#define STUDIO  &studio_unlock
ZMK_BASE_LAYER(System,
//╭────────┲━━━━━━━━┳━━━━━━━━┳━━━━━━━━┳━━━━━━━━┳━━━━━━━━┓  ┏━━━━━━━━┳━━━━━━━━┳━━━━━━━━┳━━━━━━━━┳━━━━━━━━┱────────╮ //
     ____    BTK(0)   BTK(1)   BTK(2)   BTK(3)   BTK(4) ,     NONE     NONE     NONE     NONE     NONE     ____  ,
//├────────╊━━━━━━━━╋━━━━━━━━╋━━━━━━━━╋━━━━━━━━╋━━━━━━━━┫  ┣━━━━━━━━╋━━━━━━━━╋━━━━━━━━╋━━━━━━━━╋━━━━━━━━╉────────┤ //
  &bt BT_CLR  NONE     NONE     NONE     NONE    STUDIO ,     NONE     NONE     NONE     NONE     NONE     NONE  ,
//├────────╊━━━━━━━━╋━━━━━━━━╋━━━━━━━━╋━━━━━━━━╋━━━━━━━━┫  ┣━━━━━━━━╋━━━━━━━━╋━━━━━━━━╋━━━━━━━━╋━━━━━━━━╉────────┤ //
     ____     NONE     NONE     NONE     NONE     NONE  ,     NONE     NONE     NONE     NONE     NONE     ____  ,
//╰────────┺━━━━━━━━┻━━━━━━━━╇━━━━━━━━╇━━━━━━━━╇━━━━━━━━┩  ┡━━━━━━━━╇━━━━━━━━╇━━━━━━━━╇━━━━━━━━┻━━━━━━━━┹────────╯ //
                                ____     ____     ____  ,     ____     ____     ____
//                           ╰────────┴────────┴────────╯  ╰────────┴────────┴────────╯                            //
)


// Combo keys
// -----------------------------------------------------------------------------
// Unfortunately, there is just that much keys one can use on a small keyboard,
// and not all the functionalities I want for my base layer fit on a 42-keys
// keyboard. The solution for that is to use Combo keys, so I can make two keys
// that make sense to be pressed together, to behave in a different way.
//
// Notice that Combo keys require the keys to be defined as numbers
// representing their physical position in the keyboard. Because of that, each
// keyboard mapping will have to define a macro for each combo on this layout.
// The names of these macros should follow the following syntax:
//
// COMBO_KEY_<combo-name>
#define COMBO_KEY_CAPS_WORD <LM2 RM2>
/ {
    combos {
        compatible = "zmk,combos";

        // Turn on CAPS_WORD when pressing both shift keys together.
        combo_caps_word {
            timeout-ms = <75>;
            key-positions = COMBO_KEY_CAPS_WORD;
            layers = <L_ENTHIUM L_KVANT>;
            bindings = <&caps_word>;
        };
    };
};

/*                     KEY POSITIONS

  ╭─────────────────────────╮ ╭─────────────────────────╮
  │ LT5 LT4 LT3 LT2 LT1 LT0 │ │ RT0 RT1 RT2 RT3 RT4 RT5 │
  │ LM5 LM4 LM3 LM2 LM1 LM0 │ │ RM0 RM1 RM2 RM3 RM4 RM5 │
  │ LB5 LB4 LB3 LB2 LB1 LB0 │ │ RB0 RB1 RB2 RB3 RB4 RB5 │
  ╰───────────╮ LH2 LH1 LH0 │ │ RH0 RH1 RH2 ╭───────────╯
              ╰─────────────╯ ╰─────────────╯ */

#define COMBO_TERM_FAST 20
#define COMBO_TERM_SLOW 30

#define COMBO_IDLE_FAST 150
#define COMBO_IDLE_SLOW 50

// Backspace and delete
ZMK_COMBO(lbrc, C_BSPC, RT1 RT2, L_BASE, COMBO_TERM_FAST, COMBO_IDLE_FAST)
ZMK_COMBO(rbrc, C_DEL, RT2 RT3, L_BASE, COMBO_TERM_FAST, COMBO_IDLE_FAST)

// Parentheses and angle brackets
HOMEROW_COMBO(lpar, &lpar_lt, RM1 RM2, L_BASE, COMBO_TERM_FAST, COMBO_IDLE_FAST, RC(RSHFT), KEYS_L)
HOMEROW_COMBO(rpar, &rpar_gt, RM2 RM3, L_BASE, COMBO_TERM_FAST, COMBO_IDLE_FAST, RC(RALT),  KEYS_L)

// Brackets and braces
ZMK_COMBO(lbkt, &kp LBKT, RB1 RB2, L_BASE, COMBO_TERM_FAST, COMBO_IDLE_FAST)
ZMK_COMBO(rbkt, &kp RBKT, RB2 RB3, L_BASE, COMBO_TERM_FAST, COMBO_IDLE_FAST)


// Layer switching
// -----------------------------------------------------------------------------
/ {
    behaviors {
        // Tap:        Sticky Number-Symbol Layer
        // Shift-tap:  -
        // Double-tap: Toggle Number-Symbol Layer
        // Hold:       -
        // Morph:      -
        stgl_numsym: sticky_or_toggle_layer_numsym {
            compatible = "zmk,behavior-tap-dance";
            #binding-cells = <0>;
            tapping-term-ms = <200>;
            bindings = <&sl L_NUMSYM>, <&tog L_NUMSYM>;
        };
    };
};
